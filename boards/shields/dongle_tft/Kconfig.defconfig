## boards/shields/dongle_tft/Kconfig.shield
```kconfig
# SPDX-License-Identifier: MIT

config SHIELD_DONGLE_TFT
	def_bool $(shields_list_contains,dongle_tft)
```

## boards/shields/example_dongle/Kconfig.shield
```kconfig
# SPDX-License-Identifier: MIT

config SHIELD_EXAMPLE_DONGLE
	def_bool $(shields_list_contains,example_dongle)
```
